/*
 * bsp_oled.c
 *
 *  Created on: Nov 1, 2026
 *      Author: zakar
 */


#include "main.h"
#include "bsp_oled.h"

static uint8_t oled_buf[512];

/* 5x7 font, ASCII 32 (space) to 126 (~). 5 column bytes per character, bit 0 = top. */
static const uint8_t oled_font[95][5] = {
    {0x00,0x00,0x00,0x00,0x00}, {0x00,0x00,0x5F,0x00,0x00}, {0x00,0x07,0x00,0x07,0x00}, /*   ! " */
    {0x14,0x7F,0x14,0x7F,0x14}, {0x24,0x2A,0x7F,0x2A,0x12}, {0x23,0x13,0x08,0x64,0x62}, /* # $ % */
    {0x36,0x49,0x55,0x22,0x50}, {0x00,0x05,0x03,0x00,0x00}, {0x00,0x1C,0x22,0x41,0x00}, /* & ' ( */
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    {0x00,0x41,0x36,0x08,0x00}, {0x10,0x08,0x08,0x10,0x08}                              /* } ~   */
};

static void OLED_SCL_Low(void){
	HAL_GPIO_WritePin(OLED_SCL_GPIO_Port, OLED_SCL_Pin, RESET);

}

static void OLED_SCL_High(void){
	HAL_GPIO_WritePin(OLED_SCL_GPIO_Port, OLED_SCL_Pin, SET);
}

static void OLED_SDA_Low(void){
	HAL_GPIO_WritePin(OLED_SDA_GPIO_Port, OLED_SDA_Pin, RESET);

}

static void OLED_SDA_High(void){
	HAL_GPIO_WritePin(OLED_SDA_GPIO_Port, OLED_SDA_Pin, SET);
}


static uint8_t OLED_SDA_Read(void){
	return HAL_GPIO_ReadPin(OLED_SDA_GPIO_Port, OLED_SDA_Pin);
}

static void OLED_Delay(void){

	for(volatile uint32_t i=0; i < 50; i++){
	}
}


static void OLED_Start(void){
	OLED_SDA_High();
	OLED_Delay();
	OLED_SCL_High();
	OLED_Delay();
	OLED_SDA_Low();
	OLED_Delay();
	OLED_SCL_Low();
	OLED_Delay();
}

static void OLED_Stop(void){
	OLED_SDA_Low();
	OLED_Delay();
	OLED_SCL_High();
	OLED_Delay();
	OLED_SDA_High();
	OLED_Delay();
}


static uint8_t OLED_WriteByte(uint8_t byte){
	uint8_t ack;
	for(uint8_t i = 0; i < 8; i++){
		if((byte & 0x80) != 0){
			OLED_SDA_High();
		}
		else{
			OLED_SDA_Low();
		}
		OLED_Delay();
		OLED_SCL_High();
		OLED_Delay();
		OLED_SCL_Low();
		OLED_Delay();
		byte <<= 1;
	}
	OLED_SDA_High();
	OLED_Delay();
	OLED_SCL_High();
	OLED_Delay();
	if(OLED_SDA_Read() == 0){
		ack = 1;
	}
	else{
		ack =0;
	}
	OLED_SCL_Low();
	OLED_Delay();
	return ack;
}





static void OLED_WriteCommand(uint8_t cmd){
	OLED_Start();
	OLED_WriteByte(0x78);
	OLED_WriteByte(0x00);
	OLED_WriteByte(cmd);
	OLED_Stop();
}




/* SSD1306 start-up commands for a 128x32 panel (from the datasheet) */
static const uint8_t init_cmds[] = {
	0xAE,        /* display off while we set it up            */
	0xD5, 0x80,  /* display clock: default speed              */
	0xA8, 0x1F,  /* 32 rows (0x1F = 31, counted from 0)       */
	0xD3, 0x00,  /* no vertical shift                         */
	0x40,        /* start drawing at RAM row 0                */
	0x8D, 0x14,  /* charge pump ON (makes ~7 V for the pixels) */
	0x20, 0x00,  /* RAM fills left to right, then next row    */
	0xA1,        /* mirror left/right                         */
	0xC8,        /* flip top/bottom                           */
	0xDA, 0x02,  /* pin layout for 128x32 panels              */
	0x81, 0x8F,  /* brightness 0..255                         */
	0xD9, 0xF1,  /* pixel pre-charge time                     */
	0xDB, 0x40,  /* pixel "off" voltage level                 */
	0xA4,        /* TEST: all pixels on (step 4: change to 0xA4) */
	0xA6,        /* normal colours, white on black            */
	0xAF         /* display ON                                */
};

uint8_t OLED_Init(void){
	uint8_t found;
	OLED_SDA_High();
	OLED_SCL_High();
	HAL_Delay(100);

	/* is the OLED there? */
	OLED_Start();
	found = OLED_WriteByte(0x3C << 1);
	OLED_Stop();
	if(found == 0){
		return 0;
	}

	/* send every command in the table, one by one */
	for(uint8_t i = 0; i < sizeof(init_cmds); i++){
		OLED_WriteCommand(init_cmds[i]);
	}
	OLED_Clear();
	OLED_Update();
	return 1;
}


void OLED_Clear(void){
	for(uint16_t i =0; i<sizeof(oled_buf); i++){
		oled_buf[i]=0;
	}
}


void OLED_SetPixel(uint8_t x, uint8_t y, uint8_t on){
	uint16_t index = (y / 8) * 128 + x;
	if(x>=128 || y>=32){
		return;
	}
	if(on == 1){
		oled_buf[index] |= (1 << (y % 8));
	}
	else{
		oled_buf[index] &= ~(1 << (y % 8));
	}
}

/* draw one 5x7 letter with its top-left corner at (x, y) */
void OLED_DrawChar(uint8_t x, uint8_t y, char c){
	if(c < ' ' || c > '~'){
		c = '?';                      /* not in the font table */
	}
	for(uint8_t col = 0; col < 5; col++){
		uint8_t bits = oled_font[c - ' '][col];   /* one column, bit 0 = top */
		for(uint8_t row = 0; row < 8; row++){
			OLED_SetPixel(x + col, y + row, (bits >> row) & 1);
		}
	}
}

/* draw a string; each letter takes 6 pixels (5 + 1 gap) */
void OLED_Print(uint8_t x, uint8_t y, const char *text){
	while(*text != '\0'){
		OLED_DrawChar(x, y, *text);
		x += 6;
		text++;
	}
}

/* draw a number with one decimal, e.g. -12.3 */
void OLED_PrintFloat(uint8_t x, uint8_t y, float value){
	char text[12];
	uint8_t n = 0;          /* letters written into text so far */
	uint8_t negative = 0;
	int32_t tenths, whole;
	char digits[10];
	uint8_t d = 0;

	if(value < 0){
		negative = 1;
		value = -value;
	}
	tenths = (int32_t)(value * 10.0f + 0.5f);   /* 12.34 -> 123 (rounded) */
	if(negative && tenths > 0){
		text[n++] = '-';                        /* no "-0.0" */
	}
	whole = tenths / 10;                        /* 123 -> 12 */
	do{                                         /* digits come out backwards: 2, 1 */
		digits[d++] = '0' + (whole % 10);
		whole /= 10;
	}while(whole > 0 && d < 9);
	while(d > 0){                               /* copy them the right way round */
		text[n++] = digits[--d];
	}
	text[n++] = '.';
	text[n++] = '0' + (tenths % 10);            /* 123 -> 3 */
	text[n] = '\0';                             /* end of string */

	OLED_Print(x, y, text);
}

void OLED_Update(void){
	/* write area: columns 0..127, pages 0..3 = whole screen */
	OLED_WriteCommand(0x21);
	OLED_WriteCommand(0);
	OLED_WriteCommand(127);
	OLED_WriteCommand(0x22);
	OLED_WriteCommand(0);
	OLED_WriteCommand(3);

	/* one message: address, "picture data follows", 512 bytes */
	OLED_Start();
	OLED_WriteByte(0x78);
	OLED_WriteByte(0x40);
	for(uint16_t i = 0; i < sizeof(oled_buf); i++){
		OLED_WriteByte(oled_buf[i]);
	}
	OLED_Stop();
}
